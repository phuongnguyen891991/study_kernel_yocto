## meta-sharemmap/conf/layer.conf
```bitbake
# We have a conf and classes directory, add to BBPATH
BBPATH .= ":${LAYERDIR}"

# We have recipes-* directories, add to BBFILES
BBFILES += "${LAYERDIR}/recipes-*/*/*.bb \
            ${LAYERDIR}/recipes-*/*/*.bbappend"

BBFILE_COLLECTIONS += "meta-sharemmap"
BBFILE_PATTERN_meta-sharemmap = "^${LAYERDIR}/"
BBFILE_PRIORITY_meta-sharemmap = "6"

LAYERDEPENDS_meta-sharemmap = "core"
LAYERSERIES_COMPAT_meta-sharemmap = "warrior"
```

## meta-usermmap/conf/layer.conf
```bitbake
# We have a conf and classes directory, add to BBPATH
BBPATH .= ":${LAYERDIR}"

# We have recipes-* directories, add to BBFILES
BBFILES += "${LAYERDIR}/recipes-*/*/*.bb \
            ${LAYERDIR}/recipes-*/*/*.bbappend"

BBFILE_COLLECTIONS += "meta-usermmap"
BBFILE_PATTERN_meta-usermmap = "^${LAYERDIR}/"
BBFILE_PRIORITY_meta-usermmap = "6"

LAYERDEPENDS_meta-usermmap = "core"
LAYERSERIES_COMPAT_meta-usermmap = "warrior"
```
